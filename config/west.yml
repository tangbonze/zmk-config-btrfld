## config/west.yml
```yaml
manifest:
  remotes:
    - name: solidhal
      url-base: https://github.com/SolidHal
  projects:
    - name: zmk
      remote: solidhal
      revision: main
      import: app/west.yml
  self:
    path: config
```
